## xiaozhi-v2/sdkconfig.defaults.weiwu-x1-wifi
```kconfig
# weiwu-x1-wifi board default config

# ESP32S3 base config
CONFIG_ESPTOOLPY_FLASHSIZE_8MB=y
CONFIG_ESPTOOLPY_FLASHMODE_DIO=y

CONFIG_ESP_DEFAULT_CPU_FREQ_MHZ_240=y

# PSRAM config (3V Octal PSRAM - AP Memory AP64M)
CONFIG_SPIRAM=y
CONFIG_SPIRAM_MODE_OCT=y
CONFIG_SPIRAM_TYPE_AUTO=y
CONFIG_SPIRAM_CLK_IO=30
CONFIG_SPIRAM_CS_IO=26
CONFIG_SPIRAM_SPEED_80M=y
CONFIG_SPIRAM_BOOT_HW_INIT=y
CONFIG_SPIRAM_BOOT_INIT=y
CONFIG_SPIRAM_PRE_CONFIGURE_MEMORY_PROTECTION=y
CONFIG_SPIRAM_USE_MALLOC=y
CONFIG_SPIRAM_FETCH_INSTRUCTIONS=y
CONFIG_SPIRAM_RODATA=y
CONFIG_SPIRAM_MALLOC_ALWAYSINTERNAL=4096
CONFIG_SPIRAM_MALLOC_RESERVE_INTERNAL=65536
CONFIG_SPIRAM_MEMTEST=n
CONFIG_MBEDTLS_EXTERNAL_MEM_ALLOC=y

# Cache config
CONFIG_ESP32S3_INSTRUCTION_CACHE_32KB=y
CONFIG_ESP32S3_DATA_CACHE_64KB=y
CONFIG_ESP32S3_DATA_CACHE_LINE_64B=y

# Partition Table (v1.5.2 compatible format)
CONFIG_PARTITION_TABLE_CUSTOM=y
CONFIG_PARTITION_TABLE_CUSTOM_FILENAME="partitions/v2/8m_compatible.csv"
CONFIG_PARTITION_TABLE_OFFSET=0x8000

# Wake word model
CONFIG_SR_WN_WN9_NIHAOXIAOZHI_TTS=y

# Board type
CONFIG_BOARD_TYPE_WEIWU_X1_WIFI=y

# Disable display (this board has no display)
CONFIG_DISPLAY_ENABLE=n
```
